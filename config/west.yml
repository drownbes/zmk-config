## config/west.yml
```yaml
manifest:
  remotes:
    - name: krikun98
      url-base: https://github.com/krikun98
  projects:
    - name: zmk
      remote: krikun98
      revision: nrf85833
      import: app/west.yml
  self:
    path: config
```
